print -((3 + 5) * (6 - -3));
print 2;
print 69;
print 4;
